## Documentation/devicetree/bindings/mfd/x-powers,ac200.yaml
```yaml
# SPDX-License-Identifier: (GPL-2.0-only OR BSD-2-Clause)
%YAML 1.2
---
$id: http://devicetree.org/schemas/mfd/x-powers,ac200.yaml#
$schema: http://devicetree.org/meta-schemas/core.yaml#

title: X-Powers AC200 mixed-signal IC

maintainers:
  - James Hilliard <james.hilliard1@gmail.com>

description:
  The AC200 is a mixed-signal companion IC containing audio, video, RTC and
  Fast Ethernet PHY functions. Its control registers are accessed over I2C.

properties:
  compatible:
    const: x-powers,ac200

  reg:
    maxItems: 1

  clocks:
    maxItems: 1
    description:
      AC200 input clock. When using the Ethernet PHY, its configured rate must
      be 24 or 27 MHz, matching the rates encoded by the documented EPHY clock
      selector.

  interrupts:
    maxItems: 1
    description:
      The INTB pin, which is a shared open-drain, level-triggered output for
      the TV encoder, Ethernet PHY and RTC interrupt sources.

  interrupt-controller: true

  '#interrupt-cells':
    const: 1
    description:
      The interrupt number, as defined in
      include/dt-bindings/mfd/x-powers,ac200.h.

  ac-ldoin-supply:
    description: 3.3 V supply for the audio-codec LDO input

  ephy-vcc-supply:
    description: 3.3 V supply for the Ethernet PHY analog front end

  rtc-vcc-supply:
    description: 3.3 V supply for the RTC

  tv-vcc-supply:
    description: 3.3 V supply for the TV encoder DAC

  nvmem-cells:
    maxItems: 1
    description:
      Optional SoC SID cell containing the AC200 bandgap calibration value.
      The trim is used by the TV encoder; the public AC200 datasheet does not
      document the corresponding register fields.

  nvmem-cell-names:
    const: bandgap

  ethernet-phy-control:
    $ref: /schemas/net/x-powers,ac200-ephy-ctl.yaml#

required:
  - compatible
  - reg
  - clocks
  - ac-ldoin-supply
  - ephy-vcc-supply
  - rtc-vcc-supply
  - tv-vcc-supply

dependencies:
  interrupts: [ interrupt-controller ]
  interrupt-controller: [ '#interrupt-cells', interrupts ]
  '#interrupt-cells': [ interrupt-controller ]
  nvmem-cells: [ nvmem-cell-names ]
  nvmem-cell-names: [ nvmem-cells ]

additionalProperties: false

examples:
  - |
    #include <dt-bindings/interrupt-controller/irq.h>

    i2c {
        #address-cells = <1>;
        #size-cells = <0>;

        mixed-signal@10 {
            compatible = "x-powers,ac200";
            reg = <0x10>;
            clocks = <&pwm 5>;
            ac-ldoin-supply = <&reg_3v3>;
            ephy-vcc-supply = <&reg_3v3>;
            rtc-vcc-supply = <&reg_3v3>;
            tv-vcc-supply = <&reg_3v3>;
            interrupt-parent = <&pio>;
            interrupts = <1 20 IRQ_TYPE_LEVEL_LOW>;
            interrupt-controller;
            #interrupt-cells = <1>;
            nvmem-cells = <&ac200_bandgap>;
            nvmem-cell-names = "bandgap";

            ethernet-phy-control {
                compatible = "x-powers,ac200-ephy-ctl";
                nvmem-cells = <&ephy_calibration>;
                nvmem-cell-names = "calibration";
                phy-mode = "rmii";
            };
        };
    };
...
```

## Documentation/devicetree/bindings/mtd/allwinner,sun4i-a10-nand.yaml
```yaml
# SPDX-License-Identifier: GPL-2.0
%YAML 1.2
---
$id: http://devicetree.org/schemas/mtd/allwinner,sun4i-a10-nand.yaml#
$schema: http://devicetree.org/meta-schemas/core.yaml#

title: Allwinner A10 NAND Controller

maintainers:
  - Chen-Yu Tsai <wens@csie.org>
  - Maxime Ripard <mripard@kernel.org>

properties:
  compatible:
    enum:
      - allwinner,sun4i-a10-nand
      - allwinner,sun8i-a23-nand-controller
      - allwinner,sun50i-h616-nand-controller

  reg:
    maxItems: 1

  interrupts:
    maxItems: 1

  clocks:
    minItems: 2
    items:
      - description: Bus Clock
      - description: Module Clock
      - description: ECC Clock
      - description: MBus Clock

  clock-names:
    minItems: 2
    items:
      - const: ahb
      - const: mod
      - const: ecc
      - const: mbus

  resets:
    maxItems: 1

  reset-names:
    const: ahb

  dmas:
    maxItems: 1

  dma-names:
    const: rxtx

patternProperties:
  "^nand@[a-f0-9]$":
    type: object
    $ref: raw-nand-chip.yaml
    properties:
      reg:
        minimum: 0
        maximum: 7

      nand-ecc-algo:
        const: bch

      nand-ecc-step-size:
        enum: [ 512, 1024 ]

      nand-ecc-strength:
        maximum: 80

      allwinner,rb:
        description:
          Contains the native Ready/Busy IDs.
        $ref: /schemas/types.yaml#/definitions/uint32-array
        minItems: 1
        maxItems: 2
        items:
          minimum: 0
          maximum: 1

      allwinner,randomized-oob:
        type: boolean
        description:
          Select the normal-page format used by Allwinner NAND firmware for
          the configured controller hardware-ECC geometry. Normal page
          transfers use the controller randomizer, the bad block marker remains
          in its data stream instead of being compensated to stay plain on
          flash, and protected user data uses the controller-specific placement
          expected by the firmware.

    unevaluatedProperties: false

required:
  - compatible
  - reg
  - interrupts
  - clocks
  - clock-names

unevaluatedProperties: false

allOf:
  - $ref: nand-controller.yaml

  - if:
      properties:
        compatible:
          contains:
            enum:
              - allwinner,sun4i-a10-nand
              - allwinner,sun8i-a23-nand-controller
    then:
      properties:
        clocks:
          maxItems: 2
        clock-names:
          maxItems: 2
      patternProperties:
        "^nand@[a-f0-9]$":
          properties:
            partitions:
              patternProperties:
                "@[0-9a-f]+$":
                  properties:
                    allwinner,boot-format: false

  - if:
      properties:
        compatible:
          contains:
            enum:
              - allwinner,sun50i-h616-nand-controller
    then:
      properties:
        clocks:
          minItems: 4
        clock-names:
          minItems: 4
      required:
        - resets
        - reset-names

examples:
  - |
    #include <dt-bindings/interrupt-controller/arm-gic.h>
    #include <dt-bindings/clock/sun50i-h616-ccu.h>
    #include <dt-bindings/reset/sun50i-h616-ccu.h>

    nand-controller@4011000 {
        compatible = "allwinner,sun50i-h616-nand-controller";
        reg = <0x04011000 0x1000>;
        interrupts = <GIC_SPI 34 IRQ_TYPE_LEVEL_HIGH>;
        clocks = <&ccu CLK_BUS_NAND>, <&ccu CLK_NAND0>,
                 <&ccu CLK_NAND1>, <&ccu CLK_MBUS_NAND>;
        clock-names = "ahb", "mod", "ecc", "mbus";
        resets = <&ccu RST_BUS_NAND>;
        reset-names = "ahb";
        #address-cells = <1>;
        #size-cells = <0>;

        nand@0 {
            reg = <0>;
            allwinner,rb = <0>;
            nand-bus-width = <8>;
            nand-ecc-step-size = <1024>;
            nand-ecc-strength = <32>;

            partitions {
                compatible = "fixed-partitions";
                #address-cells = <1>;
                #size-cells = <1>;

                partition@0 {
                    allwinner,boot-format;
                    reg = <0x0 0x40000>;
                    label = "spl";
                };

                partition@80000 {
                    allwinner,boot-format;
                    reg = <0x80000 0x40000>;
                    label = "spl-backup";
                };

                partition@100000 {
                    reg = <0x100000 0x400000>;
                    label = "uboot";
                };
            };
        };
    };

...
```

## Documentation/devicetree/bindings/net/x-powers,acx00-ephy.yaml
```yaml
# SPDX-License-Identifier: (GPL-2.0-only OR BSD-2-Clause)
%YAML 1.2
---
$id: http://devicetree.org/schemas/net/x-powers,acx00-ephy.yaml#
$schema: http://devicetree.org/meta-schemas/core.yaml#

title: X-Powers AC200 and AC300 Ethernet PHY

maintainers:
  - James Hilliard <james.hilliard1@gmail.com>

description:
  The AC200 and AC300 contain compatible Fast Ethernet link-PHY
  implementations which report the same PHY ID, but use different control
  interfaces. Systems with a fixed companion IC describe one control
  interface, which must already be enabled. A fixed AC300 system may provide
  an NVMEM configuration field to select its calibration range; omitting the
  field selects the normal range. Systems that can contain either companion IC
  describe both control interfaces and require the field to select the
  matching one before the PHY identification registers are accessible. In
  that dual-control topology, the AC200 I2C controller and AC300 control
  device may use status "fail-needs-probe" so the selected one can be enabled
  dynamically. The PHY node's reg value is programmed through the AC200
  control interface. For AC300, it must match the address selected by the
  package straps.

select:
  properties:
    compatible:
      contains:
        const: ethernet-phy-id0044.1400
  required:
    - compatible
  anyOf:
    - required:
        - x-powers,ac200-control
    - required:
        - x-powers,ac300-control

properties:
  compatible:
    const: ethernet-phy-id0044.1400

  nvmem-cells:
    maxItems: 1
    description:
      Logical SoC SID field whose bit 0 selects the AC300 control interface in
      a dual-control topology and whose bit 1 selects its low-calibration
      tuning sequence.

  nvmem-cell-names:
    description:
      In a dual-control topology the configuration field uses bit 0 to select
      AC200 (zero) or AC300 (one). Bit 1 selects the AC300 vendor sequence for
      a low-level calibration value in both dual and fixed AC300 topologies.
    const: configuration

  x-powers,ac200-control:
    $ref: /schemas/types.yaml#/definitions/phandle
    description: Reference to the AC200 Ethernet PHY control function

  x-powers,ac300-control:
    $ref: /schemas/types.yaml#/definitions/phandle
    description: Reference to the AC300 MDIO Ethernet PHY control device

  x-powers,xmii-rx-clock-inverted:
    type: boolean
    description:
      Invert the xMII receive clock inside the PHY. This is required by some
      SoC integrations, including the Allwinner H6 AC200 connection.

  wakeup-source:
    $ref: /schemas/types.yaml#/definitions/flag
    description:
      Indicates that the PHY interrupt is routed to a wake-capable interrupt
      controller and may be used for magic-packet or link-change Wake-on-LAN.

  leds:
    type: object
    description: |
      Package LED outputs. Output 0 indicates link and flashes for transmit or
      receive activity, output 1 indicates a 100 Mbps link, and output 2
      indicates full duplex and flashes on a half-duplex collision. The
      polarity setting is shared by all outputs, so active-high or active-low
      declarations on different children must agree. Without an leds
      container, all three outputs are enabled active-low to match the vendor
      initialization. An explicit container replaces that fallback: only
      outputs described by available child nodes are enabled, with active-low
      used when no child specifies a polarity.

    properties:
      '#address-cells':
        const: 1

      '#size-cells':
        const: 0

    patternProperties:
      '^led@[0-2]$':
        type: object
        $ref: /schemas/leds/common.yaml#

        properties:
          reg:
            enum: [0, 1, 2]

          inactive-high-impedance: false

        required:
          - reg

        unevaluatedProperties: false

    additionalProperties: false

required:
  - compatible

oneOf:
  - properties:
      nvmem-cells: false
      nvmem-cell-names: false
      x-powers,ac300-control: false
    required:
      - x-powers,ac200-control
  - properties:
      x-powers,ac200-control: false
    required:
      - x-powers,ac300-control
  - required:
      - nvmem-cells
      - nvmem-cell-names
      - x-powers,ac200-control
      - x-powers,ac300-control

dependentRequired:
  nvmem-cells: [ nvmem-cell-names ]
  nvmem-cell-names: [ nvmem-cells ]

allOf:
  - $ref: ethernet-phy.yaml#
  - if:
      required:
        - x-powers,ac300-control
    then:
      properties:
        reg:
          maximum: 7

unevaluatedProperties: false

examples:
  - |
    #include <dt-bindings/leds/common.h>

    mdio {
        #address-cells = <1>;
        #size-cells = <0>;

        ethernet-phy@0 {
            compatible = "ethernet-phy-id0044.1400";
            reg = <0>;
            nvmem-cells = <&ephy_config>;
            nvmem-cell-names = "configuration";
            x-powers,ac300-control = <&ac300_ephy_ctl>;

            leds {
                #address-cells = <1>;
                #size-cells = <0>;

                led@0 {
                    reg = <0>;
                    color = <LED_COLOR_ID_GREEN>;
                    function = LED_FUNCTION_LAN;
                    active-low;
                    default-state = "keep";
                };

                led@1 {
                    reg = <1>;
                    color = <LED_COLOR_ID_YELLOW>;
                    function = LED_FUNCTION_LAN;
                    function-enumerator = <1>;
                    active-low;
                    default-state = "keep";
                };
            };
        };
    };

  - |
    mdio {
        #address-cells = <1>;
        #size-cells = <0>;

        ethernet-phy@0 {
            compatible = "ethernet-phy-id0044.1400";
            reg = <0>;
            x-powers,ac200-control = <&ac200_ephy_ctl>;
        };
    };

  - |
    mdio {
        #address-cells = <1>;
        #size-cells = <0>;

        ethernet-phy@0 {
            compatible = "ethernet-phy-id0044.1400";
            reg = <0>;
            nvmem-cells = <&ephy_config>;
            nvmem-cell-names = "configuration";
            x-powers,ac200-control = <&ac200_ephy_ctl>;
            x-powers,ac300-control = <&ac300_ephy_ctl>;
        };
    };
...
```
